## boards/shields/kaizen/Kconfig.defconfig
```kconfig
if SHIELD_KAIZEN
config ZMK_KEYBOARD_NAME
    default "Kaizen"

config SPI
    default y
endif
```

## boards/shields/kaizen/Kconfig.shield
```kconfig
config SHIELD_TOTEM_7RACKER_LEFT
    def_bool $(shields_list_contains,totem-7racker_left)
    select SPI
```

## config/west.yml
```yaml
manifest:
  remotes:
    - name: zmkfirmware
      url-base: https://github.com/zmkfirmware
    - name: fingerpunch
      url-base: https://github.com/sadekbaroudi
  projects:
    - name: zmk
      remote: zmkfirmware
      revision: main
      import: app/west.yml
    - name: zmk-fingerpunch-vik
      remote: fingerpunch
      revision: main
      import: config/deps.yml
  self:
    path: config
```
